

uint8_t lcd_st7565r_font_10_15_matrix[ ] = {
	0x00, 0x00, 0x00, 0x00, 0x00, 0x00, 0x00, 0x00, 0x00, 0x00, 0x00, 0x00, 0x00, 0x00, 0x00, 0x00, 0x00, 0x00, 0x00, 0x00, 	/*   */
	0x00, 0x00, 0x00, 0x00, 0xFC, 0x0D, 0xFC, 0x0D, 0x00, 0x00, 0x00, 0x00, 0x00, 0x00, 0x00, 0x00, 0x00, 0x00, 0x00, 0x00, 	/* ! */
	0x00, 0x00, 0x3C, 0x00, 0x3C, 0x00, 0x00, 0x00, 0x3C, 0x00, 0x3C, 0x00, 0x00, 0x00, 0x00, 0x00, 0x00, 0x00, 0x00, 0x00, 	/* " */
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	0x08, 0x00, 0x04, 0x00, 0x04, 0x00, 0x08, 0x00, 0x10, 0x00, 0x10, 0x00, 0x08, 0x00, 0x00, 0x00, 0x00, 0x00, 0x00, 0x00, 	/* ~ */
};

lcd_st7565r_Font_t	lcd_st7565r_font_10_15 = {
	.chWidth = 10,
	.chHeight = 15,
	.chFirst = ' ',
	.chLast = '~',
	.chMatrix = lcd_st7565r_font_10_15_matrix
};

